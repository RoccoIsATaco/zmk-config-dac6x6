## config/Kconfig.shield
```kconfig
config SHIELD_DAC6X6_LEFT
    def_bool $(shields_list_contains,dac6x6_left)

config SHIELD_DAC6X6_RIGHT
    def_bool $(shields_list_contains,dac6x6_right)
```

## config/boards/shields/dac6x6/Kconfig.defconfig
```kconfig
if SHIELD_DAC6X6_LEFT

    config ZMK_KEYBOARD_NAME
        default "dac6x6"

    config ZMK_SPLIT_BLE_ROLE_CENTRAL
        default y
endif

if SHIELD_DAC6X6_LEFT || SHIELD_DAC6X6_RIGHT

    config ZMK_SPLIT
        default y

endif
```
